## main/Kconfig.projbuild
```kconfig
menu "Project James"

    config JAMES_AUDIO_CAPTURE_DIAGNOSTIC
        bool "Enable P4 microphone capture diagnostic"
        default y
        help
            Initialize the Waveshare ES8311 microphone path at 16 kHz mono,
            run a 20 ms capture task on Core 1, and log one-second signal and
            health summaries. This is a diagnostic baseline; it does not save
            or transmit audio and does not perform VAD.

    config JAMES_AUDIO_MIC_GAIN_DB
        int "ES8311 microphone input gain (dB)"
        depends on JAMES_AUDIO_CAPTURE_DIAGNOSTIC
        range 0 42
        default 24
        help
            Initial diagnostic microphone gain. Tune from measured peak,
            clipping, and noise-floor results rather than perceived loudness.

    config JAMES_AUDIO_SPEAKER_VOLUME
        int "ES8311 speaker volume (percent)"
        depends on JAMES_AUDIO_CAPTURE_DIAGNOSTIC
        range 0 100
        default 95
        help
            Initial half-duplex response playback volume. Begin conservatively
            and raise only after confirming the attached speaker is 8 ohm and
            no more than 2 W.

    config JAMES_AUDIO_RING_FRAMES
        int "Bounded audio queue capacity (20 ms frames)"
        depends on JAMES_AUDIO_CAPTURE_DIAGNOSTIC
        range 10 100
        default 25
        help
            Number of fixed PCM frames retained between capture and consumers.
            The default is 500 ms and uses approximately 16 KiB. If consumers
            stall, the oldest frame is discarded so microphone capture never
            waits for networking, storage, or diagnostics.

    config JAMES_PTT_PROTOTYPE
        bool "Enable BOOT-button PTT and Pi gateway voice loop"
        depends on JAMES_AUDIO_CAPTURE_DIAGNOSTIC
        default y
        help
            Use the Waveshare BOOT button as active-low push-to-talk. Hold to
            capture 16 kHz mono PCM, release to send it to Titanium, and play
            the returned 16 kHz PCM through the ES8311/NS4150B speaker path.

    if JAMES_PTT_PROTOTYPE

        config JAMES_PTT_GPIO
            int "Temporary PTT GPIO"
            range 0 54
            default 35
            help
                GPIO35 is the BOOT button on the Waveshare ESP32-P4-WIFI6.
                Holding it while resetting still enters download mode.

        config JAMES_PTT_MAX_SECONDS
            int "Maximum PTT utterance length (seconds)"
            range 2 30
            default 20

        config JAMES_GATEWAY_URI
            string "James Pi WebSocket URI"
            default "ws://192.168.8.107:8090/ws/v1"

    endif

endmenu
```
